## conf/machine/rockchip-rk3399-tinker_board_2.conf
```bitbake
# Copyright (c) 2019, Fuzhou Rockchip Electronics Co., Ltd
# Released under the MIT license (see COPYING.MIT for the terms)

#@TYPE: Machine
#@NAME: RK3399 Tinker Board 2

require conf/machine/include/rk3399.inc

KERNEL_DEVICETREE = "rockchip/rk3399-tinker_board_2.dtb"

UBOOT_MACHINE = "tinker_board_2_defconfig"

KBUILD_DEFCONFIG = "tinker_board_2_defconfig"

MACHINE_EXTRA_RRECOMMENDS:append = " \
	linux-firmware-rk-cdndp \
	asus-overlay \
	networkmanager \
	networkmanager-nmcli \
	networkmanager-nmtui \
	vim \
	exfat-utils \
	fuse-exfat \
	ntfs-3g \
	gptfdisk \
	usbutils \
	ntpdate \
"
```
